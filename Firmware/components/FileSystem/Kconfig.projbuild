## Firmware/components/FileSystem/Kconfig.projbuild
```kconfig
menu "ConfigImage Configuration"
    config DEVICE_CONFIGURATION_FILENAME
        string "Device Configuration"
        default "IOConfiguration.json"
        help
            File on Spiffs-Partition to load Device configuration

    config FACTORY_IMAGE_FILENAME
        string "Device Version"
        default "Device.json"
        help
            File on Spiffs-Partition to load Device version

endmenu
```

## Firmware/main/Kconfig.projbuild
```kconfig
menu "App Configuration"

    config ESP_WIFI_SSID
        string "WiFi SSID"
        default "myssid"
        help
            SSID (network name) for the example to connect to.

    config ESP_WIFI_PASSWORD
        string "WiFi Password"
        default "mypassword"
        help
            WiFi password (WPA or WPA2) for the example to use.

    config ESP_MAX_STA_CONN
        int "Maximal STA connections"
        default 4
        help
            Max number of the STA connects to AP.

    config WEB_MOUNT_POINT
        string "Website mount point in server"
        default "/server"
        help
            Specify the mount point for server partition. This is the spiffs partition name in partitions.csv

    config SETUP_MOUNT_POINT
        string "Partition mount point for storage files"
        default "/storage"
        help
            Specify the mount point for storage partition. This is the spiffs partition name in partitions.csv
endmenu
```

## Firmware/sdkconfig.defaults
```kconfig
CONFIG_IDF_TARGET="esp32"
CONFIG_HTTPD_MAX_REQ_HDR_LEN=1024
CONFIG_ESP_WIFI_SSID="cLight"
CONFIG_ESP_WIFI_PASSWORD="FiatLux!"
CONFIG_ESP_MAX_STA_CONN=4
CONFIG_LWIP_LOCAL_HOSTNAME="LightController"

# Flash and Partition Options
CONFIG_ESPTOOLPY_FLASHSIZE_16MB=y
CONFIG_ESPTOOLPY_FLASHSIZE="16MB"

CONFIG_PARTITION_TABLE_CUSTOM=y
CONFIG_PARTITION_TABLE_CUSTOM_FILENAME="partitions.csv"
CONFIG_PARTITION_TABLE_FILENAME="partitions.csv"


# Files
CONFIG_DEVICE_CONFIGURATION_FILENAME="IOConfiguration.json"
CONFIG_FACTORY_IMAGE_FILENAME="Device.json"
CONFIG_WEB_MOUNT_POINT="/server"
CONFIG_SETUP_MOUNT_POINT="/spiffs"
```
